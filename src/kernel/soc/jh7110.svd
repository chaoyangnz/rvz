# StarFive VisionFive 2 v1.3b register map
File version: 0.1
From StarFive VisionFive 2 v1.3b,model device generator
Registers are 32-bit, read-write, no defined reset value unless marked. A register's access mark holds for its fields unless they carry their own. Offsets are from the block's base; lines under a group give offsets from that group; [hi:lo] are bit positions; {n}, {i} and the like mark numbered series; 'fields as' and 'values as' point back to an identical list; <NAME> marks a mode.

## Memory map
0x00000000 jedec_spi_nor_0 — From jedec,spi-nor, peripheral generator
0x00000050 atmel_24c04_0 size 0x50 — From atmel,24c04, peripheral generator
0x02000000 starfive_jh7110_clint_0 size 0x10000 — From starfive,jh7110-clint, peripheral generator
0x02000000 sifive_clint0_0 size 0x10000 — From sifive,clint0, peripheral generator
0x02010000 starfive_jh7110_ccache_0 size 0x4000 — From starfive,jh7110-ccache, peripheral generator
0x02010000 sifive_ccache0_0 size 0x4000 — From sifive,ccache0, peripheral generator
0x02010000 cache_0 size 0x4000 — From cache, peripheral generator
0x0C000000 starfive_jh7110_plic_0 size 0x4000000 — From starfive,jh7110-plic, peripheral generator
0x0C000000 sifive_plic0_0 size 0x4000000 — From sifive,plic0, peripheral generator
0x10000000 snps_dw_apb_uart_0 size 0x10000 — From snps,dw-apb-uart, peripheral generator
0x10010000 snps_dw_apb_uart_1 size 0x10000 — From snps,dw-apb-uart, peripheral generator
0x10020000 snps_dw_apb_uart_2 size 0x10000 — From snps,dw-apb-uart, peripheral generator
0x10030000 snps_designware_i2c_0 size 0x10000 — From snps,designware-i2c, peripheral generator
0x10040000 snps_designware_i2c_1 size 0x10000 — From snps,designware-i2c, peripheral generator
0x10050000 snps_designware_i2c_2 size 0x10000 — From snps,designware-i2c, peripheral generator
0x10230000 starfive_jh7110_stgcrg_0 size 0x10000 — From starfive,jh7110-stgcrg, peripheral generator
0x10240000 starfive_jh7110_stg_syscon_0 size 0x1000 — From starfive,jh7110-stg-syscon, peripheral generator
0x10240000 syscon_0 size 0x1000 — From syscon, peripheral generator
0x12000000 snps_dw_apb_uart_3 size 0x10000 — From snps,dw-apb-uart, peripheral generator
0x12010000 snps_dw_apb_uart_4 size 0x10000 — From snps,dw-apb-uart, peripheral generator
0x12020000 snps_dw_apb_uart_5 size 0x10000 — From snps,dw-apb-uart, peripheral generator
0x12030000 snps_designware_i2c_3 size 0x10000 — From snps,designware-i2c, peripheral generator
0x12040000 snps_designware_i2c_4 size 0x10000 — From snps,designware-i2c, peripheral generator
0x12050000 snps_designware_i2c_5 size 0x10000 — From snps,designware-i2c, peripheral generator
0x12060000 snps_designware_i2c_6 size 0x10000 — From snps,designware-i2c, peripheral generator
0x120D0000 starfive_jh7110_pwm_0 size 0x10000 — From starfive,jh7110-pwm, peripheral generator
0x13020000 starfive_jh7110_syscrg_0 size 0x10000 — From starfive,jh7110-syscrg, peripheral generator
0x13030000 starfive_jh7110_sys_syscon_0 size 0x1000 — From starfive,jh7110-sys-syscon, peripheral generator
0x13030000 syscon_1 size 0x1000 — From syscon, peripheral generator
0x13030000 simple_mfd_0 size 0x1000 — From simple-mfd, peripheral generator
0x13040000 starfive_jh7110_sys_pinctrl_0 size 0x10000 — From starfive,jh7110-sys-pinctrl, peripheral generator
0x16010000 snps_dw_mshc_0 size 0x10000 — From snps,dw-mshc, peripheral generator
0x16020000 snps_dw_mshc_1 size 0x10000 — From snps,dw-mshc, peripheral generator
0x16030000 starfive_jh7110_dwmac_0 size 0x10000 — From starfive,jh7110-dwmac, peripheral generator
0x16030000 snps_dwmac_5_20_0 size 0x10000 — From snps,dwmac-5_20, peripheral generator
0x16040000 starfive_jh7110_dwmac_1 size 0x10000 — From starfive,jh7110-dwmac, peripheral generator
0x16040000 snps_dwmac_5_20_1 size 0x10000 — From snps,dwmac-5_20, peripheral generator
0x17000000 starfive_jh7110_aoncrg_0 size 0x10000 — From starfive,jh7110-aoncrg, peripheral generator
0x17010000 starfive_jh7110_aon_syscon_0 size 0x1000 — From starfive,jh7110-aon-syscon, peripheral generator
0x17010000 syscon_2 size 0x1000 — From syscon, peripheral generator
0x17020000 starfive_jh7110_aon_pinctrl_0 size 0x10000 — From starfive,jh7110-aon-pinctrl, peripheral generator
0x2B000000 starfive_jh7110_pcie_0 size 0x1000000 — From starfive,jh7110-pcie,reg peripheral generator
0x2C000000 starfive_jh7110_pcie_2 size 0x1000000 — From starfive,jh7110-pcie,reg peripheral generator
0x940000000 starfive_jh7110_pcie_1 size 0x10000000 — From starfive,jh7110-pcie,config peripheral generator
0x9C0000000 starfive_jh7110_pcie_3 size 0x10000000 — From starfive,jh7110-pcie,config peripheral generator
