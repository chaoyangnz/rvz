# D1H register map
Vendor: Allwinner; File version: 1.0
Registers are 32-bit, read-write, reset 0x0 unless marked. A register's access mark holds for its fields unless they carry their own. Offsets are from the block's base; [hi:lo] are bit positions; lines under a group give offsets from that group; {n}, {i} and the like mark numbered series.

## DSP_MSGBOX — DSP Message Box
Base 0x01701000
Same registers: RISC_V_MSGBOX 0x0601F000
{0x20+0x100*i} MSGBOX_RD_IRQ_EN_REG_{i} (i=0..1) — MSGBOX Read IRQ Enable Register
{0x24+0x100*i} MSGBOX_RD_IRQ_STATUS_REG_{i} (i=0..1) — MSGBOX Read IRQ Status Register
{0x30+0x100*i} MSGBOX_WR_IRQ_EN_REG_{i} (i=0..1) — MSGBOX Write IRQ Enable Register
{0x34+0x100*i} MSGBOX_WR_IRQ_STATUS_REG_{i} (i=0..1) — MSGBOX Write IRQ Status Register
{0x40+0x100*i} MSGBOX_DEBUG_REG_{i} (i=0..1) — MSGBOX Debug Register
{0x50+0x100*i} MSGBOX_FIFO_STATUS_REG_N{i} (i=0..1) group — MSGBOX FIFO Status Register
  {0x0+4j} MSGBOX_FIFO_STATUS_REG_P{j} (j=0..2) — MSGBOX FIFO Status Register
{0x60+0x100*i} MSGBOX_MSG_STATUS_REG_N{i} (i=0..1) group — MSGBOX Message Status Register
  {0x0+4j} MSGBOX_MSG_STATUS_REG_P{j} (j=0..2) — MSGBOX Message Status Register
{0x70+0x100*i} MSGBOX_MSG_REG_N{i} (i=0..1) group — MSGBOX Message Queue Register
  {0x0+4j} MSGBOX_MSG_REG_P{j} (j=0..2) — MSGBOX Message Queue Register
{0x80+0x100*i} MSGBOX_WR_INT_THRESHOLD_REG_N{i} (i=0..1) group — MSGBOX Write IRQ Threshold Register
  {0x0+4j} MSGBOX_WR_INT_THRESHOLD_REG_P{j} (j=0..2) — MSGBOX Write IRQ Threshold Register

## Spinlock
Base 0x03005000
0x00 SPINLOCK_SYSTATUS_REG — Spinlock System Status Register
0x10 SPINLOCK_STATUS_REG — Spinlock Status Register
0x20 SPINLOCK_IRQ_EN_REG — Spinlock Interrupt Enable Register
0x40 SPINLOCK_IRQ_STA_REG — Spinlock Interrupt Status Register
{0x80+4i} SPINLOCK_LOCKID{i}_REG (i=0..4) — Spinlock Lockid{i} Register
{0x100+4i} SPINLOCK_LOCK_REG{i} (i=0..31) — Spinlock Register

## RTC — Real Time CLock
Base 0x07090000
0x00 LOSC_CTRL_REG — Low Oscillator Control Register
0x04 LOSC_AUTO_SWT_STA_REG — LOSC Auto Switch Status Register
0x08 INTOSC_CLK_PRESCAL_REG — Internal OSC Clock Pre-scalar Register
0x10 RTC_DAY_REG — RTC Year-Month-Day Register
0x14 RTC_HH_MM_SS_REG — RTC Hour-Minute-Second Register
0x20 ALARM0_DAY_SET_REG — Alarm 0 Day Setting Register
0x24 ALARM0_CUR_VLU_REG — Alarm 0 Counter Current Value Register
0x28 ALARM0_ENABLE_REG — Alarm 0 Enable Register
0x2C ALARM0_IRQ_EN — Alarm 0 IRQ Enable Register
0x30 ALARM0_IRQ_STA_REG — Alarm 0 IRQ Status Register
0x50 ALARM_CONFIG_REG — Alarm Configuration Register
0x60 _32K_FOUT_CTRL_GATING_REG — 32K Fanout Control Gating Register
{0x100+4i} GP_DATA_REG{i} (i=0..7) — General Purpose Register
0x120 FBOOT_INFO_REG0 — Fast Boot Information Register0
0x124 FBOOT_INFO_REG1 — Fast Boot Information Register1
0x160 DCXO_CTRL_REG — DCXO Control Register
0x190 RTC_VIO_REG — RTC_VIO Regulation Register
0x1F0 IC_CHARA_REG — IC Characteristic Register
0x1F4 VDD_OFF_GATING_CTRL_REG — VDD Off Gating Control Register
0x204 EFUSE_HV_PWRSWT_CTRL_REG — Efuse High Voltage Power Switch Control Register
0x310 RTC_SPI_CLK_CTRL_REG — RTC SPI Clock Control Register

## TCON_LCD0 — Timing COntroller LCD
Base 0x05461000
0x00 LCD_GCTL_REG — LCD Global Control Register
0x04 LCD_GINT0_REG — LCD Global Interrupt Register0
0x08 LCD_GINT1_REG — LCD Global Interrupt Register1
0x10 LCD_FRM_CTL_REG — LCD FRM Control Register
{0x14+4i} LCD_FRM_SEED_REG{i} (i=0..5) — LCD FRM Seed Register
{0x2C+4i} LCD_FRM_TAB_REG{i} (i=0..3) — LCD FRM Table Register
0x3C LCD_3D_FIFO_REG — LCD 3D FIFO Register
0x40 LCD_CTL_REG — LCD Control Register
0x44 LCD_DCLK_REG — LCD Data Clock Register
{0x48+4i} LCD_BASIC{i}_REG (i=0..3) — LCD Basic Timing Register{i}
0x58 LCD_HV_IF_REG — LCD HV Panel Interface Register
0x60 LCD_CPU_IF_REG — LCD CPU Panel Interface Register
0x64 LCD_CPU_WR_REG — LCD CPU Panel Write Data Register
0x68 LCD_CPU_RD0_REG — LCD CPU Panel Read Data Register0
0x6C LCD_CPU_RD1_REG — LCD CPU Panel Read Data Register1
0x84 LCD_LVDS_IF_REG — LCD LVDS Configure Register
0x88 LCD_IO_POL_REG — LCD IO Polarity Register
0x8C LCD_IO_TRI_REG — LCD IO Control Register
0xFC LCD_DEBUG_REG — LCD Debug Register
0x100 LCD_CEU_CTL_REG — LCD CEU Control Register
{0x110+4i} LCD_CEU_COEF_MUL_REG{i} (i=0..2) — LCD CEU Coefficient Register0
{0x11C+0x10*i} LCD_CEU_COEF_ADD_REG{i} (i=0..2) — LCD CEU Coefficient Register1
{0x140+4i} LCD_CEU_COEF_RANG_REG{i} (i=0..2) — LCD CEU Coefficient Register2
{0x160+4i} LCD_CPU_TRI{i}_REG (i=0..5) — LCD CPU Panel Trigger Register{i}
0x180 LCD_CMAP_CTL_REG — LCD Color Map Control Register
0x190 LCD_CMAP_ODD0_REG — LCD Color Map Odd Line Register0
0x194 LCD_CMAP_ODD1_REG — LCD Color Map Odd Line Register1
0x198 LCD_CMAP_EVEN0_REG — LCD Color Map Even Line Register0
0x19C LCD_CMAP_EVEN1_REG — LCD Color Map Even Line Register1
0x1F0 LCD_SAFE_PERIOD_REG — LCD Safe Period Register
0x220 LCD_LVDS0_ANA_REG — LCD LVDS Analog Register 0
0x224 LCD_LVDS1_ANA_REG — LCD LVDS Analog Register 1
0x230 LCD_SYNC_CTL_REG — LCD Sync Control Register
0x234 LCD_SYNC_POS_REG — LCD Sync Position Register
0x238 LCD_SLAVE_STOP_POS_REG — LCD Slave Stop Position Register
0x244 LCD_LVDS1_IF_REG — LCD LVDS1 IF Register
{0x400+4i} LCD_GAMMA_TABLE_REG{i} (i=0..255) — LCD Gamma Table Register
